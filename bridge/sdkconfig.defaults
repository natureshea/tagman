## bridge/sdkconfig.defaults
```kconfig
# Bluetooth: NimBLE host, controller in BLE-only mode
CONFIG_BT_ENABLED=y
CONFIG_BT_NIMBLE_ENABLED=y
CONFIG_BTDM_CTRL_MODE_BLE_ONLY=y
CONFIG_BTDM_CTRL_MODE_BR_EDR_ONLY=n
CONFIG_BTDM_CTRL_MODE_BTDM=n

# WiFi + BT software coexistence (REQUIRED on classic ESP32 to run both)
CONFIG_ESP_COEX_SW_COEXIST_ENABLE=y

# NimBLE roles: we are a central (client) that also scans
CONFIG_BT_NIMBLE_ROLE_CENTRAL=y
CONFIG_BT_NIMBLE_ROLE_OBSERVER=y
CONFIG_BT_NIMBLE_ROLE_PERIPHERAL=n
CONFIG_BT_NIMBLE_ROLE_BROADCASTER=n

# HTTP server
CONFIG_HTTPD_MAX_REQ_HDR_LEN=1024

# Flash size (board has 4MB)
CONFIG_ESPTOOLPY_FLASHSIZE_4MB=y
CONFIG_PARTITION_TABLE_SINGLE_APP_LARGE=y
```
